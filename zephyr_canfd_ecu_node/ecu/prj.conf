## CMakeLists.txt
```
cmake_minimum_required(VERSION 3.20.0)

find_package(Zephyr REQUIRED HINTS $ENV{ZEPHYR_BASE})
project(zephyr_canfd_ecu_node)

target_sources(app PRIVATE
    src/main.cpp
    src/physics_model.cpp
    src/can_fd_frames.cpp
    src/ecu_state_machine.cpp
)

target_include_directories(app PRIVATE src)
```

## prj.conf
```kconfig
# Kernel Features
CONFIG_LOG=y
CONFIG_MAIN_STACK_SIZE=2048

# C++ Support
CONFIG_CPP=y
CONFIG_STD_CPP17=y
CONFIG_NEWLIB_LIBC=y

# CAN Bus Support
CONFIG_CAN=y
CONFIG_CAN_FD_MODE=y
CONFIG_CAN_NATIVE_LINUX=y
CONFIG_CAN_MAX_FILTER=5
```

## boards/native_sim.overlay
```dts
/ {
	chosen {
		zephyr,canbus = &can0;
	};
};

&can0 {
	status = "okay";
	bus-speed = <500000>;
	bus-speed-data = <2000000>;
};
```

## src/main.cpp
```c
#include <zephyr/kernel.h>
#include <zephyr/device.h>
#include <zephyr/drivers/can.h>
#include <zephyr/logging/log.h>
#include <string.h>

#include "physics_model.h"
#include "can_fd_frames.h"
#include "ecu_state_machine.h"

LOG_MODULE_REGISTER(ecu_main, LOG_LEVEL_INF);

CAN_MSGQ_DEFINE(cmd_msgq, 8);

static EcuStateMachine state_machine;

static void state_change_callback(const struct device *dev, enum can_state state,
				  struct can_bus_err_cnt err_cnt, void *user_data)
{
	EcuStateMachine *fsm = static_cast<EcuStateMachine*>(user_data);
	if (state == CAN_STATE_BUS_OFF) {
		LOG_ERR("CAN controller Bus-Off state detected!");
		fsm->set_bus_off(true);
	} else if (fsm->get_state() == EcuState::FAULT && state != CAN_STATE_BUS_OFF) {
		fsm->set_bus_off(false);
	}
}

int main(void)
{
	LOG_INF("Starting Zephyr CAN-FD ECU Node...");

	const struct device *const can_dev = DEVICE_DT_GET(DT_CHOSEN(zephyr_canbus));
	if (!device_is_ready(can_dev)) {
		LOG_ERR("CAN controller device not ready");
		return -1;
	}

	int err = can_set_mode(can_dev, CAN_MODE_FD);
	if (err != 0) {
		LOG_ERR("Failed to set CAN-FD mode: %d", err);
		return -1;
	}

	can_set_state_change_callback(can_dev, state_change_callback, &state_machine);

	struct can_filter filter = {
		.id = COMMAND_CAN_ID,
		.mask = CAN_STD_CID_MASK,
		.flags = 0
	};
	int filter_id = can_add_rx_filter_msgq(can_dev, &cmd_msgq, &filter);
	if (filter_id < 0) {
		LOG_ERR("Failed to register command filter: %d", filter_id);
		return -1;
	}

	uint16_t seq = 0;
	uint32_t start_time = k_uptime_get_32();

	LOG_INF("ECU initialized, starting main loop");

	while (1) {
		uint32_t loop_start = k_uptime_get_32();
		double dt = 1.0 / state_machine.get_telemetry_rate();

		struct can_frame cmd_frame;
		while (k_msgq_get(&cmd_msgq, &cmd_frame, K_NO_WAIT) == 0) {
			CommandFrame cmd;
			if (unpack_command(cmd_frame.data, cmd_frame.dlc, cmd)) {
				uint8_t status = state_machine.handle_command(cmd);
				LOG_INF("CMD ID 0x%02X executed with status %d", cmd.command_id, status);

				struct can_frame resp_frame;
				resp_frame.id = RESPONSE_CAN_ID;
				resp_frame.flags = 0;
				resp_frame.dlc = 8;
				ResponseFrame resp;
				pack_response(cmd.command_id, status, resp);
				memcpy(resp_frame.data, &resp, sizeof(ResponseFrame));

				int tx_err = can_send(can_dev, &resp_frame, K_MSEC(10), NULL, NULL);
				if (tx_err != 0) {
					LOG_WRN("Failed to send response frame: %d", tx_err);
				}
			}
		}

		state_machine.update(dt);

		if (state_machine.get_state() != EcuState::FAULT && state_machine.get_fault_bitmap() == 0) {
			enum can_state curr_state;
			struct can_bus_err_cnt err_cnt;
			can_get_state(can_dev, &curr_state, &err_cnt);
			if (curr_state == CAN_STATE_BUS_OFF) {
				LOG_INF("Triggering CAN bus recovery...");
				can_recover(can_dev, K_MSEC(100));
			}
		}

		struct can_frame tel_frame;
		tel_frame.id = TELEMETRY_CAN_ID;
		tel_frame.flags = CAN_FRAME_FDF | CAN_FRAME_BRS;
		tel_frame.dlc = can_bytes_to_dlc(sizeof(TelemetryFrame));
		
		TelemetryFrame tel;
		uint32_t uptime_s = (k_uptime_get_32() - start_time) / 1000;
		pack_telemetry(state_machine.get_physics().get_state(), 
		               state_machine.get_fault_bitmap(), 
		               seq++, 
		               uptime_s, 
		               tel);
		memcpy(tel_frame.data, &tel, sizeof(TelemetryFrame));

		int tx_err = can_send(can_dev, &tel_frame, K_MSEC(10), NULL, NULL);
		if (tx_err != 0) {
			LOG_WRN("Failed to send telemetry frame: %d", tx_err);
		}

		uint32_t loop_duration = k_uptime_get_32() - loop_start;
		uint32_t period_ms = static_cast<uint32_t>(dt * 1000.0);
		if (loop_duration < period_ms) {
			k_msleep(period_ms - loop_duration);
		} else {
			k_yield();
		}
	}

	return 0;
}
```

## src/can_fd_frames.cpp
```c
#include "can_fd_frames.h"
#include <string.h>

static inline uint16_t swap16(uint16_t val) {
    return (val << 8) | (val >> 8);
}

static inline uint32_t swap32(uint32_t val) {
    return ((val >> 24) & 0xff) |
           ((val << 8) & 0xff0000) |
           ((val >> 8) & 0xff00) |
           ((val << 24) & 0xff000000);
}

static inline bool is_little_endian() {
    uint16_t number = 0x1;
    char *numPtr = (char*)&number;
    return (numPtr[0] == 1);
}

static inline uint16_t host_to_be16(uint16_t val) {
    return is_little_endian() ? swap16(val) : val;
}

static inline int16_t host_to_be16_signed(int16_t val) {
    return (int16_t)host_to_be16((uint16_t)val);
}

static inline uint32_t host_to_be32(uint32_t val) {
    return is_little_endian() ? swap32(val) : val;
}

void pack_telemetry(const PhysicsState& state, uint32_t fault_bitmap, uint16_t seq, uint32_t uptime, TelemetryFrame& frame) {
    frame.rpm = host_to_be16(static_cast<uint16_t>(state.rpm));
    frame.coolant_temp = host_to_be16_signed(static_cast<int16_t>(state.coolant_temp * 256.0));
    frame.oil_pressure = host_to_be16(static_cast<uint16_t>(state.oil_pressure));
    frame.battery_voltage = host_to_be16(static_cast<uint16_t>(state.battery_voltage * 100.0));
    frame.fuel_level = host_to_be16(static_cast<uint16_t>(state.fuel_level * 10.0));
    frame.vehicle_speed = host_to_be16(static_cast<uint16_t>(state.vehicle_speed * 10.0));
    frame.ambient_temp = host_to_be16_signed(static_cast<int16_t>(state.ambient_temp * 256.0));
    frame.fault_bitmap = host_to_be32(fault_bitmap);
    frame.sequence_counter = host_to_be16(seq);
    frame.uptime = host_to_be32(uptime);
    memset(frame.reserved, 0, sizeof(frame.reserved));
}

bool unpack_command(const uint8_t* data, size_t len, CommandFrame& cmd) {
    if (len < sizeof(CommandFrame)) {
        return false;
    }
    memcpy(&cmd, data, sizeof(CommandFrame));
    return true;
}

void pack_response(uint8_t command_id, uint8_t status, ResponseFrame& resp) {
    resp.command_id = command_id;
    resp.status = status;
    memset(resp.reserved, 0, sizeof(resp.reserved));
}
```

## src/can_fd_frames.h
```c
#ifndef CAN_FD_FRAMES_H
#define CAN_FD_FRAMES_H

#include <stdint.h>
#include <stddef.h>
#include "physics_model.h"

#define TELEMETRY_CAN_ID 0x100
#define COMMAND_CAN_ID   0x200
#define RESPONSE_CAN_ID  0x201

#pragma pack(push, 1)
struct TelemetryFrame {
    uint16_t rpm;
    int16_t coolant_temp;
    uint16_t oil_pressure;
    uint16_t battery_voltage;
    uint16_t fuel_level;
    uint16_t vehicle_speed;
    int16_t ambient_temp;
    uint32_t fault_bitmap;
    uint16_t sequence_counter;
    uint32_t uptime;
    uint8_t reserved[24];
};
#pragma pack(pop)

static_assert(sizeof(TelemetryFrame) == 48, "TelemetryFrame size must be exactly 48 bytes");

#pragma pack(push, 1)
struct CommandFrame {
    uint8_t command_id;
    uint8_t param_u8;
    uint8_t reserved[6];
};
#pragma pack(pop)

static_assert(sizeof(CommandFrame) == 8, "CommandFrame size must be exactly 8 bytes");

#pragma pack(push, 1)
struct ResponseFrame {
    uint8_t command_id;
    uint8_t status;
    uint8_t reserved[6];
};
#pragma pack(pop)

static_assert(sizeof(ResponseFrame) == 8, "ResponseFrame size must be exactly 8 bytes");

void pack_telemetry(const PhysicsState& state, uint32_t fault_bitmap, uint16_t seq, uint32_t uptime, TelemetryFrame& frame);
bool unpack_command(const uint8_t* data, size_t len, CommandFrame& cmd);
void pack_response(uint8_t command_id, uint8_t status, ResponseFrame& resp);

#endif // CAN_FD_FRAMES_H
```

## src/ecu_state_machine.cpp
```c
#include "ecu_state_machine.h"

#define FAULT_OVER_TEMP          0x00000001
#define FAULT_LOW_OIL_PRESSURE   0x00000002
#define FAULT_LOW_BATTERY        0x00000004
#define FAULT_BUS_OFF            0x00000008

EcuStateMachine::EcuStateMachine() 
    : state_(EcuState::INIT), fault_bitmap_(0), diag_timer_(0.0), bus_off_(false) {
}

EcuState EcuStateMachine::get_state() const {
    return state_;
}

uint32_t EcuStateMachine::get_fault_bitmap() const {
    return fault_bitmap_;
}

double EcuStateMachine::get_telemetry_rate() const {
    return (state_ == EcuState::DIAGNOSTIC) ? 100.0 : 50.0;
}

PhysicsModel& EcuStateMachine::get_physics() {
    return physics_;
}

const PhysicsModel& EcuStateMachine::get_physics() const {
    return physics_;
}

void EcuStateMachine::set_bus_off(bool bus_off) {
    bus_off_ = bus_off;
    if (bus_off_) {
        fault_bitmap_ |= FAULT_BUS_OFF;
        state_ = EcuState::FAULT;
    } else {
        fault_bitmap_ &= ~FAULT_BUS_OFF;
    }
}

void EcuStateMachine::trigger_bus_recovery() {
    bus_off_ = false;
    fault_bitmap_ &= ~FAULT_BUS_OFF;
}

void EcuStateMachine::evaluate_faults() {
    const auto& s = physics_.get_state();
    
    // Evaluate Over-Temp
    if (s.coolant_temp > 110.0) {
        fault_bitmap_ |= FAULT_OVER_TEMP;
    } else if (s.coolant_temp < 105.0) {
        fault_bitmap_ &= ~FAULT_OVER_TEMP;
    }

    // Evaluate Low Oil Pressure (only when engine running / RPM > 800)
    if (s.rpm > 800.0 && s.oil_pressure < 150.0) {
        fault_bitmap_ |= FAULT_LOW_OIL_PRESSURE;
    } else if (s.rpm <= 800.0 || s.oil_pressure > 180.0) {
        fault_bitmap_ &= ~FAULT_LOW_OIL_PRESSURE;
    }

    // Evaluate Low Battery
    if (s.battery_voltage < 11.0) {
        fault_bitmap_ |= FAULT_LOW_BATTERY;
    } else if (s.battery_voltage > 11.5) {
        fault_bitmap_ &= ~FAULT_LOW_BATTERY;
    }

    if (bus_off_) {
        fault_bitmap_ |= FAULT_BUS_OFF;
    }
}

void EcuStateMachine::update(double dt) {
    if (state_ == EcuState::INIT) {
        state_ = EcuState::NORMAL;
        return;
    }

    physics_.step(dt);
    evaluate_faults();

    if (state_ != EcuState::FAULT) {
        if (fault_bitmap_ != 0) {
            state_ = EcuState::FAULT;
        }
    }

    if (state_ == EcuState::DIAGNOSTIC) {
        diag_timer_ += dt;
        if (diag_timer_ >= 5.0) {
            diag_timer_ = 0.0;
            state_ = EcuState::NORMAL;
        }
    }
}

uint8_t EcuStateMachine::handle_command(const CommandFrame& cmd) {
    switch (cmd.command_id) {
        case 0x01: { // SET_MODE
            uint8_t target_mode = cmd.param_u8;
            if (target_mode == 0) {
                state_ = EcuState::INIT;
                return 0;
            } else if (target_mode == 1) {
                if (state_ == EcuState::FAULT && fault_bitmap_ != 0) {
                    return 2;
                }
                state_ = EcuState::NORMAL;
                return 0;
            } else if (target_mode == 2) {
                if (state_ == EcuState::FAULT) {
                    return 2;
                }
                state_ = EcuState::DIAGNOSTIC;
                diag_timer_ = 0.0;
                return 0;
            } else if (target_mode == 3) {
                state_ = EcuState::FAULT;
                return 0;
            }
            return 1;
        }
        case 0x02: { // SET_THROTTLE
            if (cmd.param_u8 > 100) {
                return 1;
            }
            physics_.set_throttle(static_cast<double>(cmd.param_u8));
            return 0;
        }
        case 0x03: { // REQUEST_DIAG
            if (state_ == EcuState::FAULT) {
                return 2;
            }
            state_ = EcuState::DIAGNOSTIC;
            diag_timer_ = 0.0;
            return 0;
        }
        case 0x04: { // CLEAR_FAULTS
            if (state_ == EcuState::FAULT) {
                trigger_bus_recovery();
                evaluate_faults();
                if (fault_bitmap_ == 0) {
                    state_ = EcuState::NORMAL;
                    return 0;
                } else {
                    return 2;
                }
            }
            return 0;
        }
        default:
            return 1;
    }
}
```

## src/ecu_state_machine.h
```c
#ifndef ECU_STATE_MACHINE_H
#define ECU_STATE_MACHINE_H

#include "physics_model.h"
#include "can_fd_frames.h"

enum class EcuState {
    INIT,
    NORMAL,
    DIAGNOSTIC,
    FAULT
};

class EcuStateMachine {
public:
    EcuStateMachine();
    void update(double dt);
    uint8_t handle_command(const CommandFrame& cmd);
    
    EcuState get_state() const;
    uint32_t get_fault_bitmap() const;
    double get_telemetry_rate() const; // 50.0 Hz or 100.0 Hz
    
    void set_bus_off(bool bus_off);
    void trigger_bus_recovery();

    PhysicsModel& get_physics();
    const PhysicsModel& get_physics() const;

private:
    void evaluate_faults();
    
    EcuState state_;
    PhysicsModel physics_;
    uint32_t fault_bitmap_;
    double diag_timer_;
    bool bus_off_;
};

#endif // ECU_STATE_MACHINE_H
```

## src/physics_model.cpp
```c
#include "physics_model.h"
#include <algorithm>

PhysicsModel::PhysicsModel() {
    reset();
}

void PhysicsModel::set_throttle(double throttle) {
    state_.throttle = std::clamp(throttle, 0.0, 100.0);
}

void PhysicsModel::step(double dt) {
    // 1st order lag for RPM: target = 800 + throttle * 52
    double target_rpm = 800.0 + (state_.throttle * 52.0);
    // time constant = 1.0s
    state_.rpm += (target_rpm - state_.rpm) * (dt / 1.0);

    // 1st order lag for coolant temp: target = 25 + (state_.rpm / 80.0)
    double target_temp = 25.0 + (state_.rpm / 80.0);
    // time constant = 10.0s (heats slowly)
    state_.coolant_temp += (target_temp - state_.coolant_temp) * (dt / 10.0);

    // Oil pressure proportional to RPM: target = 150 + RPM * 0.1
    double target_oil = 150.0 + (state_.rpm * 0.08);
    // time constant = 0.5s
    state_.oil_pressure += (target_oil - state_.oil_pressure) * (dt / 0.5);

    // Battery voltage: fluctuates slightly around 13.8V based on RPM, 11.5V when idle
    double target_volt = (state_.rpm > 400.0) ? 13.8 : 11.5;
    state_.battery_voltage += (target_volt - state_.battery_voltage) * (dt / 2.0);

    // Vehicle speed: target = throttle * 1.8 km/h
    double target_speed = state_.throttle * 1.8;
    // time constant = 3.0s
    state_.vehicle_speed += (target_speed - state_.vehicle_speed) * (dt / 3.0);

    // Fuel level decreases slowly
    state_.fuel_level -= (0.0001 + 0.0005 * (state_.throttle / 100.0)) * dt;
    state_.fuel_level = std::max(0.0, state_.fuel_level);
}

const PhysicsState& PhysicsModel::get_state() const {
    return state_;
}

void PhysicsModel::reset() {
    state_.throttle = 0.0;
    state_.rpm = 800.0;
    state_.coolant_temp = 25.0;
    state_.oil_pressure = 214.0;
    state_.battery_voltage = 12.6;
    state_.fuel_level = 100.0;
    state_.vehicle_speed = 0.0;
    state_.ambient_temp = 22.5;
}
```

## src/physics_model.h
```c
#ifndef PHYSICS_MODEL_H
#define PHYSICS_MODEL_H

struct PhysicsState {
    double throttle;         // 0 - 100 %
    double rpm;              // RPM
    double coolant_temp;     // °C
    double oil_pressure;     // kPa
    double battery_voltage;  // V
    double fuel_level;       // %
    double vehicle_speed;    // km/h
    double ambient_temp;     // °C
};

class PhysicsModel {
public:
    PhysicsModel();
    void set_throttle(double throttle);
    void step(double dt);
    const PhysicsState& get_state() const;
    void reset();

private:
    PhysicsState state_;
};

#endif // PHYSICS_MODEL_H
```
